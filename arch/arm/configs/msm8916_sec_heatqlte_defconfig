## arch/arm/configs/msm8916_sec_heatqlte_defconfig
```kconfig
CONFIG_SEC_HEAT_PROJECT=y
CONFIG_MACH_HEAT_EUR=y

# GPIO SETTING
CONFIG_SEC_GPIO_SETTINGS=y

# MUIC
CONFIG_SM5504_MUIC=y
CONFIG_MUIC_SUPPORT_RUSTPROOF=y
CONFIG_USBID_STANDARD_VER_01=y

# DISPLAY
CONFIG_PANEL_S6E88A0_SS_WVGA=y

# TOUCHSCREEN
CONFIG_TOUCHSCREEN_CYTTSP4=y

# VIBRATOR
CONFIG_MSM_VIBRATOR=y

# SENSORS
CONFIG_SENSORS=y
CONFIG_SENSORS_CORE=y
CONFIG_SENSORS_K2HH=y
CONFIG_SENSORS_K2HH_VDD=y

# NFC
CONFIG_SEC_NFC=y
CONFIG_SEC_NFC_I2C=y
CONFIG_SEC_NFC_USE_8916_BBCLK2=y
CONFIG_SEC_NFC_IF_I2C=y
CONFIG_SEC_NFC_PRODUCT_N5=y
CONFIG_SEC_NFC_CLK_ALWAYS_ENABLE=y

# FLASH
CONFIG_FLASHLIGHT=y
CONFIG_RT_FLASH_LED=y
CONFIG_FLED_RT5033=y
CONFIG_FLED_RT5033_EXT_GPIO=y

# CAMERA #TODO
#CONFIG_S5K4ECGX=y
CONFIG_SR130PC20=y
CONFIG_CAM_DUAL_POWER_SEQ=y

# SSWAP
CONFIG_SWAP=y
CONFIG_FRONTSWAP=y
CONFIG_ZSMALLOC=y
CONFIG_ZSWAP=y

# Optimize mmc block delay on resume
CONFIG_MMC_BLOCK_DEFERRED_RESUME=y

# BATTERY
CONFIG_MFD_RT5033=y
CONFIG_MFD_RT5033_RESET_GPIO=n
CONFIG_MFD_RT5033_SLDO_VBUSDET=y
CONFIG_BATTERY_SAMSUNG=y
CONFIG_BATTERY_SAMSUNG_DATA_FILE="heat_battery_data.h"
CONFIG_SAMSUNG_LPM_MODE=y
CONFIG_CHARGER_RT5033=y
CONFIG_FUELGAUGE_RT5033=y
CONFIG_REGULATOR_RT5033=y
```
